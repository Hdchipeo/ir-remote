## main/Kconfig
```kconfig
menu "IR App Configuration"

    config LIGHT_STATE_GPIO
        int "GPIO for Light State"
        default 2
        range 0 39
        help
            Set the GPIO number used to indicate light state (default: GPIO18)

    config BUTTON_GPIO
        int "GPIO for Button"
        default 0
        range 0 39
        help
            Set the GPIO number used for the button (default: GPIO15)
    
    config RELAY_GPIO
        int "GPIO for Relay"
        default 4
        range 0 39
        help
            Set the GPIO number used for the relay (default: GPIO5)

    config IR_TX_GPIO
        int "GPIO for IR TX"
        default 12
        range 0 39
        help
            Set the GPIO number used for IR transmission (default: GPIO5)

    config IR_RX_GPIO
        int "GPIO for IR RX"
        default 13
        range 0 39
        help
            Set the GPIO number used for IR reception (default: GPIO4)

    config RMT_MEM_BLOCK_SYMBOLS
        int "RMT MEM BLOCK SYMBOLS (DMA)"
        range 64 1024
        default 128
        help
            "Size of memory block, in number of `rmt_symbol_word_t`, must be an even."
            "In the DMA mode, this field controls the DMA buffer size, it can be set to a large value (e.g. 1024)"

    config RMT_DECODE_MARGIN_US
        int "DECODE MARGIN TIME (US)"
        range 10 300
        default 200
        help
            "Allowable error margin for each symbol level"

    config RMT_SINGLE_RANGE_MAX_US
        int "SINGLE RANGE MAX TIME (US)"
        range 10000 32767
        default 20000
        help
            "RMT will stop receiving if one symbol level has kept more than this time"
    
endmenu

menu "Espnow config"


    config ESP_WIFI_SSID
        string "Wi-Fi SSID"
        default "VM04 IR Remote"
        help
            Set the SSID for the Wi-Fi network used by the application.
    config ESP_WIFI_PASS
        string "Wi-Fi Password"
        default "sehc@2025"
        help
            Set the password for the Wi-Fi network used by the application.
    config MAX_STA_CONN
        int "Max Station Connections" 
        default 4
        range 1 10
        help
            Set the maximum number of station connections allowed (default: 4)  
    config ESPNOW_CHANNEL
        int "Channel"
        default 9
        range 0 14
        help
            The channel on which sending and receiving ESPNOW data.

    config ESPNOW_PMK
        string "ESPNOW primary master key"
        default "pmk1234567890123"
        help
            ESPNOW primary master for the example to use. The length of ESPNOW primary master must be 16 bytes.

    config ESPNOW_LMK
        string "ESPNOW local master key"
        default "lmk1234567890123"
        help
            ESPNOW local master for the example to use. The length of ESPNOW local master must be 16 bytes.

    config ESPNOW_ENABLE_LONG_RANGE
        bool "Enable Long Range"
        default "n"
        help
            When enable long range, the PHY rate of ESP32 will be 512Kbps or 256Kbps

    config ESPNOW_ENABLE_POWER_SAVE
        bool "Enable ESPNOW Power Save"
        default "n"
        select ESP_WIFI_STA_DISCONNECTED_PM_ENABLE
        depends on ESPNOW_WIFI_MODE_STATION
        help
            With ESPNOW power save enabled, chip would be able to wakeup and sleep periodically
            Notice ESP_WIFI_STA_DISCONNECTED_PM_ENABLE is essential at Wi-Fi disconnected

    config ESPNOW_WAKE_WINDOW
        int "ESPNOW wake window, unit in millisecond"
        range 0 65535
        default 50
        depends on ESPNOW_ENABLE_POWER_SAVE
        help
            ESPNOW wake window

    config ESPNOW_WAKE_INTERVAL
        int "ESPNOW wake interval, unit in millisecond"
        range 1 65535
        default 100
        depends on ESPNOW_ENABLE_POWER_SAVE
        help
            ESPNOW wake interval

endmenu

menu "Werserver config"

    config HOST_NAME_WEB_SERVER
        string "Host name for web server"
        default "vm04"
        help
            Set the host name for the web server. This will be used in the URL to access the web server.
    
endmenu

menu "CONSOLE config"

    config CONSOLE_ENABLED
        bool "Enable Console"
        default "n"
        help
            Enable the console for debugging and logging purposes. This will allow you to see debug messages in the terminal.

endmenu
```

## sdkconfig.defaults
```kconfig
CONFIG_ESPTOOLPY_FLASHSIZE_4MB=y

#
# Use partition table which makes use of flash to the fullest
# Can be used for other platforms as well. But please keep in mind that fctry partition address is
# different than default, and the new address needs to be specified to `rainmaker.py claim`
#
CONFIG_PARTITION_TABLE_CUSTOM=y
CONFIG_PARTITION_TABLE_CUSTOM_FILENAME="partitions_custom.csv"

# To accomodate security features
CONFIG_PARTITION_TABLE_OFFSET=0xD000

# For IDF 5.0
CONFIG_ESP_DEFAULT_CPU_FREQ_MHZ_240=y
CONFIG_FREERTOS_HZ=1000
CONFIG_ESP_TASK_WDT_EN=n
CONFIG_FREERTOS_TIMER_TASK_STACK_DEPTH=4096


# Enable FreeRTOS stats formatting functions, needed for 'tasks' command
CONFIG_FREERTOS_USE_TRACE_FACILITY=y
CONFIG_FREERTOS_USE_STATS_FORMATTING_FUNCTIONS=y

# Reduce bootloader log verbosity
CONFIG_BOOTLOADER_LOG_LEVEL_WARN=y
CONFIG_BOOTLOADER_LOG_LEVEL=2

# On chips with USB serial, disable secondary console which does not make sense when using console component
CONFIG_ESP_CONSOLE_SECONDARY_NONE=y
CONFIG_ESP_CONSOLE_USB_SERIAL_JTAG=y
CONFIG_ESP_CONSOLE_USB_SERIAL_JTAG_ENABLED=y
```
